#include <reg52.h>

//引脚定义
sbit BUZZER = P2^3;

static unsigned int current_freq = 0;

//频率表
unsigned int code Note_Freq_Table[] = {
    0, //休止符
    64021, 64103, 64185, 64222, 64298, 64363, 64420, //1-7
    64524, 64580, 64633, 64653, 64714, 64768, 64820, //8-14
    64898, 64934, 64968, 64985, 65030, 65058, 65110  //15-21
};

//莫扎特 K.265 变奏曲
unsigned char code Mozart_Variations[] = {
    8,2, 8,2, 12,2, 12,2, 13,2, 13,2, 12,4,
    11,2, 11,2, 10,2, 10,2, 9,2, 9,2, 8,4,
    12,2, 12,2, 11,2, 11,2, 10,2, 10,2, 9,4,
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    0, 4,
    0xFF  //乐曲结束
};

//延时函数
void Delay_ms(unsigned int ms) {
    unsigned int i, j;
    for(i = ms; i > 0; i--)
        for(j = 110; j > 0; j--); 
}

//音乐初始化
void Music_Init(void) {
    TMOD &= 0xF0; 
    TMOD |= 0x01; 
    EA = 1;       
    ET0 = 1;      
    BUZZER = 1;   // 初始化保持静音
}

//乐谱播放主函数
void Music_Play(unsigned char code *song_data) {
    unsigned int i = 0; 
    
    while(song_data[i] != 0xFF) { 
        if(song_data[i] == 0) {
            current_freq = 0;
            TR0 = 0;      
            BUZZER = 1;   
        } else {
            current_freq = Note_Freq_Table[song_data[i]];
            TH0 = current_freq >> 8;   
            TL0 = current_freq & 0xFF; 
            TR0 = 1;      
        }
        
        Delay_ms(song_data[i+1] * 250);
        
        TR0 = 0;      
        BUZZER = 1;   
        Delay_ms(15); //音符间断开
        
        i += 2;
    }
}

//方波产生器
void Timer0_Routine() interrupt 1 {
    TH0 = current_freq >> 8;
    TL0 = current_freq & 0xFF;
    BUZZER = ~BUZZER; 
}

// 主程序入口
void main() {
    Music_Init(); 
    Music_Play(Mozart_Variations); 
    
    //播放完毕，程序挂起
    TR0 = 0;       
    BUZZER = 1;    
    while(1);      
}